// SPDX-License-Identifier: GPL-2.0-only
/*
 * Komodo board device tree source
 *
 * Copyright 2023 Google LLC
 */

/dts-v1/;
/plugin/;

#include "zumapro-caimito-common.dtsi"
#include "zumapro-komodo-common.dtsi"

/ {
	board_id = <0x60803>;
	board_rev = <0x010100>;
	fragment@boardbase {
		target-path = "/";
		__overlay__ {
			model = "ZUMA PRO KOMODO EVT 1.1 board based on ZUMA PRO";
			compatible = "google,ZUMA PRO KOMODO", "google,ZUMA PRO";
		};
	};
};
