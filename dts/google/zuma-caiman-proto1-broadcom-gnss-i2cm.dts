// SPDX-License-Identifier: GPL-2.0-only
/*
 * Caiman board device tree source
 *
 * Copyright 2023 Google LLC
 */

/dts-v1/;
/plugin/;

#define ZUMA_BMS_I2CM 1

#include "zuma-caimito-common.dtsi"
#include "zuma-caiman-common.dtsi"
#include "google-dts-base/zumapro-phone-gps.dtsi"

/ {
	board_id = <0x40902>;
	board_rev = <0x010004>;
	fragment@boardbase {
		target-path = "/";
		__overlay__ {
			model = "ZUMA CAIMAN Proto 1.0 Broadcom GNSS board using I2CM based on ZUMA";
			compatible = "google,ZUMA CAIMAN", "google,ZUMA";
		};
	};
};
