// SPDX-License-Identifier: GPL-2.0-only
/*
 * Komodo board device tree source
 *
 * Copyright 2023 Google LLC
 */

/dts-v1/;
/plugin/;

#include "zumapro-caimito-common.dtsi"
#include "zumapro-komodo-common.dtsi"
#include "google-dts-base/zuma-cp-s5400-phone-gnss.dtsi"
#include "zuma-caimito-gnss-samsung.dtsi"
#include "google-dts-base/max777xx-fwupdate.dtsi"

/ {
	board_id = <0x60803>;
	board_rev = <0x010101>;
	fragment@boardbase {
		target-path = "/";
		__overlay__ {
			model = "ZUMA PRO KOMODO EVT 1.1 Samsung GNSS board based on ZUMA PRO";
			compatible = "google,ZUMA PRO KOMODO", "google,ZUMA PRO";
		};
	};
};
