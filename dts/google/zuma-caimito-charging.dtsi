// SPDX-License-Identifier: GPL-2.0-only
/*
 * Charging device tree entries for the Caimito platform
 *
 * Copyright 2023 Google LLC
 *
 */
#include "google-dts-base/zuma-charging.dtsi"

&google_cpm {
	google,cop-supported;

	interrupt-parent = <&max77779_chg>;
	interrupts = <12 IRQ_TYPE_LEVEL_LOW>;
};
