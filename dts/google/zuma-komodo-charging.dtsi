// SPDX-License-Identifier: GPL-2.0-only
/*
 * Charging device tree entries for the Caimito platform
 *
 * Copyright 2024 Google LLC
 *
 */

&google_cpm {
	// thermal budgets
	google,mdis-thermal-mitigation =
	<3710000 3571000 3443000 3297000 3162000 3040000 2918000 2810000 2703000
	 2598000 2493000 2330000 2200000 2080000 1968000 1865000 1770000 1684000
	 1595000 1506000 1444000 1382000 1351000 1320000 1273000 1225000>;
	// PD+main-charger, WLC+main-charger
	google,mdis-out0-limits =
	<4000000 3860000 3720000 3580000 3440000 3300000 3160000 3020000 2880000
	 2740000 2600000 2460000 2320000 2180000 2040000 1900000 1760000 1620000
	 1480000 1340000 1200000 1060000 920000  780000  640000  500000
	 1100000 1100000 1100000 1100000 1100000 1100000 1100000 1100000 1100000
	 1100000 1100000 1100000 1050000 1000000 950000  900000  850000  800000
	 750000  700000  650000  600000  550000  500000  450000  400000>;
	// PPS_CP+pca94xx-mains, // WLC_CP+pca94xx-mains
	google,mdis-out1-limits =
	<8413000 8113000 7813000 7513000 7213000 6913000 6613000 6313000 6013000
	 5713000 5413000 5113000 4813000 4513000 4213000 3913000 3613000 3313000
	 3013000 2713000 2413000 2113000 1813000 1513000 1213000 1033000
	 5540000 5300000 5060000 4820000 4580000 4340000 4100000 3860000 3620000
	 3380000 3140000 2900000 2660000 2420000 2180000 1940000 1700000 1460000
	 1220000 1020000 920000  820000  720000  620000  520000  420000>;
};
