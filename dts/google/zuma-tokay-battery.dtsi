// SPDX-License-Identifier: GPL-2.0-only
/*
 * Battery device tree entries specific to tokay
 *
 * Copyright 2023 Google,LLC
 *
 */

&google_battery {
	google,chg-battery-capacity = <4458>;

	google,chg-cv-limits = <4200000 4300000 4350000 4480000>;
	google,chg-temp-limits = <0 100 200 420 460 480 550>;
	google,chg-cc-limits = <
		 50   30    0    0
		 70   30   30   30
		120  120  120   50
		100  100  100   50
		 50   50    0    0
		 30    0    0    0
	>;

	google,chg-topoff-limits = <250 250 250 500 500 500>;
	google,pullback-current;

#ifdef ZUMA_BMS_ENABLE_CHG_PROFILE_SWITCH
	google,enable-switch-chg-profile;
#endif

	google_debug_chg_profile {
		google,chg-battery-capacity = <4558>;

		google,chg-cv-limits = <4200000 4300000 4350000 4500000>;
		google,chg-temp-limits = <0 100 200 420 460 480 550>;
		google,chg-cc-limits = <
			 50   30    0    0
			 70   30   30   30
			120  120  120   50
			100  100  100   50
			 50   50    0    0
			 30    0    0    0
		>;

		google,chg-topoff-limits = <250 250 250 500 500 500>;
		google,pullback-current;
	};
};

&max77779_fg {
	maxim,fg-data {
#ifdef ZUMA_BMS_PROTO_EVT10_MODEL
		#include "zuma-tokay-proto-evt10-battery-data.dtsi"
#else
		#include "zuma-tokay-battery-data.dtsi"
#endif
	};
};
