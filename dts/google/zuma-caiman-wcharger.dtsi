// SPDX-License-Identifier: GPL-2.0-only
/*
 * Wireless Charger config for RA9530.
 * Intended to be included into the approriate I2C bus.
 *
 * Copyright 2023 Google LLC
 */

&ra9530 {
	/* HPP */
	google,hpp_neg_pwr = <23000>;
	google,epp_neg_pwr = <13500>;
	google,wait_prop_irq_ms = <6000>;
	/* RTx */
	idt,gpio_ben = <&ln8411_gpio 0 GPIO_ACTIVE_HIGH>;
	idt,rtx_wait_ben;
	google,wcin_inlim_en = <&max77779_gpio 0 GPIO_ACTIVE_HIGH>;
	idt,gpp-cmfet = <48>;
	/* BPP ICL */
	google,bpp_dcicl_default_ua = <700000>;
	google,bpp_dcicl_lower_vout_ua = <700000>;
	google,bpp_dcicl_lower_vout_ramp_ua = <800000>;
};

