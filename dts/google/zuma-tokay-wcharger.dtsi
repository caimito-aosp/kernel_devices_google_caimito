// SPDX-License-Identifier: GPL-2.0-only
/*
 * Wireless Charger config for RA9530.
 * Intended to be included into the approriate I2C bus.
 *
 * Copyright 2023 Google LLC
 */

&ra9530 {
	/* HPP */
	/* Disable HPP before GPP_15W is ready */
	idt,has_wlc_dc = <0>;
	google,gpp_enhanced;
	google,gpp_dcicl_ua = <1500000>;
	google,wcin_inlim_en = <&max77779_gpio 0 GPIO_ACTIVE_HIGH>;
	/* RTX */
	idt,has_rtx_gpio;
	/* BPP ICL */
	google,bpp_dcicl_default_ua = <700000>;
	google,bpp_dcicl_lower_vout_ua = <550000>;
	google,bpp_dcicl_lower_vout_ramp_ua = <800000>;
};

