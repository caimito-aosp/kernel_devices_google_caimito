// SPDX-License-Identifier: GPL-2.0-only
/*
 * Caiman board device tree source
 *
 * Copyright 2023 Google LLC
 */

/dts-v1/;
/plugin/;

#include "zumapro-caimito-common.dtsi"
#include "zumapro-caiman-common.dtsi"
#include "google-dts-base/zuma-cp-s5400-phone-gnss.dtsi"

/ {
	board_id = <0x60903>;
	board_rev = <0x010001>;
	fragment@boardbase {
		target-path = "/";
		__overlay__ {
			model = "ZUMA PRO CAIMAN EVT 1.0 Samsung GNSS board based on ZUMA PRO";
			compatible = "google,ZUMA PRO CAIMAN", "google,ZUMA PRO";
		};
	};
};
