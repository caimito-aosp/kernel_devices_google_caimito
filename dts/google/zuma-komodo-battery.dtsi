// SPDX-License-Identifier: GPL-2.0-only
/*
 * Battery device tree entries specific to panther
 *
 * Copyright 2023 Google,LLC
 *
 */

&google_battery {
	google,chg-battery-capacity = <4942>;

	google,chg-cv-limits = <4200000 4250000 4300000 4350000 4480000>;
	google,chg-temp-limits = <0 100 200 420 460 480 550>;
	google,chg-cc-limits = <
		 50   30   30    0   0
		100  100  100   50  50
		150  150  150  150  50
		150  150   50   50  50
		 50   50   50    0   0
		 30    0    0    0   0
	>;

	google,pullback-current;
};

&max77779_fg {
	maxim,fg-data {
		#include "zuma-komodo-battery-data.dtsi"
	};
};