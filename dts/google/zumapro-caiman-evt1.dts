// SPDX-License-Identifier: GPL-2.0-only
/*
 * Caiman board device tree source
 *
 * Copyright 2023 Google LLC
 */

/dts-v1/;
/plugin/;

#include "zuma-caimito-common.dtsi"
#include "zuma-caiman-common.dtsi"

/ {
	board_id = <0x60903>;
	board_rev = <0x010000>;
	fragment@boardbase {
		target-path = "/";
		__overlay__ {
			model = "ZUMA PRO CAIMAN EVT 1.0 board based on ZUMA PRO";
			compatible = "google,ZUMA PRO CAIMAN", "google,ZUMA PRO";
		};
	};
};
