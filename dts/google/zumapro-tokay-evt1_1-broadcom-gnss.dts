// SPDX-License-Identifier: GPL-2.0-only
/*
 * Tokay board device tree source
 *
 * Copyright 2023 Google LLC
 */

/dts-v1/;
/plugin/;

#include "zumapro-caimito-common.dtsi"
#include "zumapro-tokay-common.dtsi"
#include "google-dts-base/zumapro-phone-gps.dtsi"

/ {
	board_id = <0x60a03>;
	board_rev = <0x010100>;
	fragment@boardbase {
		target-path = "/";
		__overlay__ {
			model = "ZUMA PRO TOKAY EVT 1.1 Broadcom GNSS board based on ZUMA PRO";
			compatible = "google,ZUMA PRO TOKAY", "google,ZUMA PRO";
		};
	};
};
