// SPDX-License-Identifier: GPL-2.0-only
/*
 * Usecases specific to Tokay devices
 *
 * Copyright 2023 Google LLC
 *
 */

/* system use cases */
&max77779_chg {
	max77779,rtx-ready = <&p9xxx_gpio 6 GPIO_ACTIVE_HIGH>;
};
