// SPDX-License-Identifier: GPL-2.0-only
/*
 * Google ZumaPro/Tokay bcl device tree source
 *
 * Copyright (c) 2023 Google, LLC
 *		https://www.google.com
 */

&google_mitigation {
	batoilo_wlc_trig_lvl = <5000>;
	batoilo2_wlc_trig_lvl = <8000>;
};
